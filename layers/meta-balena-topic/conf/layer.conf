## layers/meta-balena-topic/conf/layer.conf
```bitbake
BBPATH .= ":${LAYERDIR}"

BBFILES += "${LAYERDIR}/recipes-*/*/*.bb \
            ${LAYERDIR}/recipes-*/*/*.bbappend"

BBFILE_COLLECTIONS += "balena-topic"
BBFILE_PATTERN_balena-topic := "^${LAYERDIR}/"
BBFILE_PRIORITY_balena-topic = "1337"

LAYERSERIES_COMPAT_balena-topic = "honister"
```

## layers/meta-balena-topic/conf/machine/lcbzu9.conf
```bitbake
# machine: Eurotec Lowpad Carrier Board with Topic Miami MPSoC Plus (Zynq Ultrascale 9EG)

MACHINE_BOARD = "lcbzu"
FPGA_FAMILY = "xczu9eg"
FPGA_FAMILY_SHORT = "xczu"
FPGA_PART = "xczu9eg-ffvb1156-1-i"

require conf/machine/include/topic-miamimp.inc

# Add SOM to overrides, takes precedence over topic-miamimp
SOM_FAMILY .= ":tspzu"

BOARD_PL_REFERENCE = "dtb-lowpad-lcb"

# Out of kernel devicetree
MACHINE_ESSENTIAL_EXTRA_RDEPENDS += "device-tree"

# Extra packages to install for the board
MACHINE_EXTRA_RRECOMMENDS += "\
	kernel-module-topic-pl-fanctrl \
	pwm-fancontrol \
	"

MACHINE_FEATURES += "rtc usbhost ethernet"

DEVICETREE = "devicetree/${MACHINE}.dtb"
DEVICETREELINKS = "\
	system.dtb ${DEVICETREE} \n\
"

# Make Xilinx happy, we don't use it...
#HDF_MACHINE = "${MACHINE}"
# Define XSA to create PMUFW and FSBL
#TOPIC_XSA_DESIGN_NAME="fpga-image-lowpad-lcb-lcb-45+110a993.xsa"
#HDF_PATH = "fpga-server.local/downloads/fpga/lowpad-lcb/${TOPIC_XSA_DESIGN_NAME};name=${HDF_MACHINE}"
```

## layers/meta-lowpad-lcb/conf/layer.conf
```bitbake
# OE layer configuration

# We have a conf directory, append to BBPATH
BBPATH .= ":${LAYERDIR}"

# We have recipes-* directories, add to BBFILES
BBFILES += "${LAYERDIR}/recipes-*/*/*.bb ${LAYERDIR}/recipes-*/*/*.bbappend"

BBFILE_COLLECTIONS += "lowpad-lcb-layer"
BBFILE_PATTERN_lowpad-lcb-layer := "^${LAYERDIR}/"

LAYERDEPENDS_lowpad-lcb-layer = "topic-layer"

LAYERSERIES_COMPAT_lowpad-lcb-layer = "honister"

# Give this layer precendence
BBFILE_PRIORITY_lowpad-lcb-layer = "20"
```
